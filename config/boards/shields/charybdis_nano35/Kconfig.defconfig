## config/boards/shields/charybdis_nano35/Kconfig.defconfig
```kconfig
if SHIELD_CHARYBDIS_NANO35_RIGHT

config ZMK_KEYBOARD_NAME
	default "Cygnus-Nano35"

config ZMK_SPLIT_BLE_ROLE_CENTRAL
	default y

endif

if SHIELD_CHARYBDIS_NANO35_LEFT || SHIELD_CHARYBDIS_NANO35_RIGHT

config ZMK_SPLIT
	default y

endif
```

## config/boards/shields/charybdis_nano35/Kconfig.shield
```kconfig
config SHIELD_CHARYBDIS_NANO35_LEFT
    def_bool $(shields_list_contains,charybdis_nano35_left)

config SHIELD_CHARYBDIS_NANO35_RIGHT
    def_bool $(shields_list_contains,charybdis_nano35_right)
```
